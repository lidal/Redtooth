// Xbox mode: an Xbox One S controller (model 1708) on Bluetooth LE firmware, for
// an 8BitDo Wireless USB Adapter 2 plugged into a Switch. Same identity, report
// layout and GATT layout as the Arduino sketch, which the adapter accepted.
#include "esp_mac.h"
#include "hid_device.h"
#include "modes.h"
#include "pad.h"
#include "settings.h"

// Report descriptor of the 1708 pad, from ESP32-BLE-CompositeHID (adapted from
// DJm00n's ControllersInfo dump): input report 1, Home report 2, rumble
// output report 3, battery report 4.
static const uint8_t s_report_map[] = {
    0x05, 0x01, 0x09, 0x05, 0xA1, 0x01, 0x85, 0x01, 0x09, 0x01, 0xA1, 0x00,
    0x09, 0x30, 0x09, 0x31, 0x15, 0x00, 0x27, 0xFF, 0xFF, 0x00, 0x00, 0x95,
    0x02, 0x75, 0x10, 0x81, 0x02, 0xC0, 0x09, 0x01, 0xA1, 0x00, 0x09, 0x32,
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    0x26, 0xFF, 0x00, 0x75, 0x08, 0x95, 0x01, 0x81, 0x02, 0xC0,
};

// Input report 1
typedef struct __attribute__((packed)) {
    uint16_t x, y;    // left stick: 0 = left/up, 0x8000 = centre, 0xFFFF = right/down
    uint16_t z, rz;   // right stick
    uint16_t brake;   // left trigger, 10 bits
    uint16_t accelerator;
    uint8_t hat;      // D-pad: 1 = up, clockwise to 8 = up-left, 0 = released
    uint16_t buttons;
    uint8_t share;
} xbox_report_t;
_Static_assert(sizeof(xbox_report_t) == 16, "Xbox input report is 16 bytes");

#define XBOX_BUTTON_A      0x0001
#define XBOX_BUTTON_B      0x0002
#define XBOX_BUTTON_LB     0x0040
#define XBOX_BUTTON_RB     0x0080
#define XBOX_BUTTON_SELECT 0x0400
#define XBOX_BUTTON_START  0x0800
#define XBOX_BUTTON_HOME   0x1000

// Microsoft (0x0006) Swift Pair beacon: beacon 0x03, scenario 0x00, RSSI 0x80
static const uint8_t s_swift_pair[] = { 0x06, 0x00, 0x03, 0x00, 0x80 };

static const hid_device_config_t s_config = {
    .name = "Xbox Wireless Controller",
    .appearance = 0x03C4,  // gamepad
    // USB vendor ID 0x045E (Microsoft), product 0x0B20 (1708 on BLE firmware), version 0x0408
    .pnp_id = { 0x02, 0x5E, 0x04, 0x20, 0x0B, 0x08, 0x04 },
    .manufacturer = "Microsoft",
    .model_number = "1708",
    // A best guess, not read from a real controller; the adapter doesn't read it
    .firmware_revision = "5.23.6.0",
    .report_map = s_report_map,
    .report_map_len = sizeof(s_report_map),
    .input_report_id = 1,
    .input_report_len = sizeof(xbox_report_t),
    .output_report_id = 3,
    .secure_connections = true,
    .adv_manufacturer_data = s_swift_pair,
    .adv_manufacturer_data_len = sizeof(s_swift_pair),
    .notify_unsubscribed = true,
    .expected_report_map_handle = 28,
};

static uint16_t stick(int8_t direction)
{
    return direction < 0 ? 0 : direction > 0 ? 0xFFFF : 0x8000;
}

static uint8_t hat(const switch_pad_t *pad)
{
    if (pad->up) return pad->right ? 2 : pad->left ? 8 : 1;
    if (pad->down) return pad->right ? 4 : pad->left ? 6 : 5;
    if (pad->right) return 3;
    if (pad->left) return 7;
    return 0;
}

static void update(uint16_t buttons)
{
    switch_pad_t pad;
    pad_map_switch(buttons, &pad);

    xbox_report_t report = {
        .x = stick(pad.lx),
        .y = stick(pad.ly),
        .z = stick(pad.rx),
        .rz = stick(pad.ry),
        .hat = hat(&pad),
        .share = pad.capture,
    };
    // The adapter maps Xbox buttons by position: Xbox B (right) -> Switch A
    if (pad.a) report.buttons |= XBOX_BUTTON_B;
    if (pad.b) report.buttons |= XBOX_BUTTON_A;
    if (pad.l) report.buttons |= XBOX_BUTTON_LB;
    if (pad.r) report.buttons |= XBOX_BUTTON_RB;
    if (pad.plus) report.buttons |= XBOX_BUTTON_START;
    if (pad.minus) report.buttons |= XBOX_BUTTON_SELECT;
    if (pad.home) report.buttons |= XBOX_BUTTON_HOME;
    hid_device_send(&report);
}

// Its own Bluetooth address, so the phone and the adapter each see a separate
// device. Clearing pairings bumps "addrgen", which changes it again.
static void start(void)
{
    uint8_t mac[6];
    esp_read_mac(mac, ESP_MAC_BT);
    mac[4] ^= 0x80;
    mac[3] ^= settings_get("addrgen", 0);
    ESP_ERROR_CHECK(esp_iface_mac_addr_set(mac, ESP_MAC_BT));
    hid_device_start(&s_config);
}

const controller_mode_t xbox_mode = {
    .name = "Xbox",
    .color = 0x00FF00,
    .start = start,
    .connected = hid_device_connected,
    .update = update,
    .set_battery = hid_device_set_battery,
    .disconnect = hid_device_disconnect,
};
